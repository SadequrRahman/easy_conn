## components/ble_conn/Kconfig
```kconfig
menu "ble_conn Configuration"
 config BLE_CONN_NAME
  string "Device name that appare in ble search"
  default "ESP32_BLE"
  help
    This a test menu
endmenu 
```

## components/uList/Kconfig
```kconfig
menu "uList Configuration"
 config Dynamic_alloc
  bool "Enable Dynamic Allocation"
  default n
  help
   Enable or disable Dynamic allocation.
endmenu 
```
